/*
 * Copyright (c) 2024 The ZMK Contributors
 *
 * SPDX-License-Identifier: MIT
 */

#include "ipacman_corne.dtsi"

&default_transform {
    col-offset = <0>;
};

&kscan0 {
    row-gpios
        = <&gpio0 4 (GPIO_ACTIVE_HIGH | GPIO_PULL_DOWN)>
        , <&gpio0 5 (GPIO_ACTIVE_HIGH | GPIO_PULL_DOWN)>
        , <&gpio0 6 (GPIO_ACTIVE_HIGH | GPIO_PULL_DOWN)>
        , <&gpio0 7 (GPIO_ACTIVE_HIGH | GPIO_PULL_DOWN)>
        , <&gpio0 8 (GPIO_ACTIVE_HIGH | GPIO_PULL_DOWN)>
        , <&gpio0 9 (GPIO_ACTIVE_HIGH | GPIO_PULL_DOWN)>
        ;

    col-gpios
        = <&gpio0 10 (GPIO_ACTIVE_HIGH | GPIO_PULL_UP)>
        , <&gpio0 14 (GPIO_ACTIVE_HIGH | GPIO_PULL_UP)>
        , <&gpio0 20 (GPIO_ACTIVE_HIGH | GPIO_PULL_UP)>
        , <&gpio0 21 (GPIO_ACTIVE_HIGH | GPIO_PULL_UP)>
        , <&gpio0 18 (GPIO_ACTIVE_HIGH | GPIO_PULL_UP)>
        , <&gpio0 22 (GPIO_ACTIVE_HIGH | GPIO_PULL_UP)>
        ;
};
