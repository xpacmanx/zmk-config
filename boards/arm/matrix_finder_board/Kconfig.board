## boards/arm/matrix_finder_board/Kconfig.board
```kconfig
config BOARD_MATRIX_FINDER_BOARD
	bool "matrix_finder_board"
	depends on SOC_NRF52840_QIAA
```

## boards/shields/ipacman_corne/Kconfig.defconfig
```kconfig
if SHIELD_IPACMAN_CORNE_LEFT

# Name must be less than 16 characters long!
config ZMK_KEYBOARD_NAME
    default "ipacman Corne"

config ZMK_SPLIT_ROLE_CENTRAL
    default y

endif

if SHIELD_IPACMAN_CORNE_LEFT || SHIELD_IPACMAN_CORNE_RIGHT

config ZMK_SPLIT
    default y

endif
```

## boards/shields/ipacman_corne/Kconfig.shield
```kconfig
# No whitespace after the comma or in your part name!
config SHIELD_IPACMAN_CORNE_LEFT
    def_bool $(shields_list_contains,ipacman_corne_left)

# No whitespace after the comma or in your part name!
config SHIELD_IPACMAN_CORNE_RIGHT
    def_bool $(shields_list_contains,ipacman_corne_right)
```

## boards/shields/matrix_finder/Kconfig.shield
```kconfig
config SHIELD_MATRIX_FINDER
    def_bool $(shields_list_contains,matrix_finder)
    select ZMK_KEYMAP_DEFAULT
```

## boards/shields/matrix_finder_shield/Kconfig.shield
```kconfig
config SHIELD_MATRIX_FINDER_SHIELD
    def_bool $(shields_list_contains,matrix_finder_shield)
```

## config/boards/shield/corne/Kconfig.defconfig
```kconfig
if SHIELD_CORNE_CUSTOM_LEFT || SHIELD_CORNE_CUSTOM_RIGHT

config ZMK_KEYBOARD_NAME
    default "Corne v4"

config ZMK_SPLIT
    default y

config ZMK_SPLIT_ROLE_CENTRAL
    default y

config ZMK_USB
    default y

config ZMK_BLE
    default y

config ZMK_EXT_POWER
    default y

config ZMK_RGB_UNDERGLOW
    default y

config ZMK_RGB_UNDERGLOW_AUTO_OFF_IDLE
    default y

config ZMK_RGB_UNDERGLOW_AUTO_OFF_USB
    default y

config ZMK_RGB_UNDERGLOW_EFF_START
    default 2

config ZMK_RGB_UNDERGLOW_ON_START
    default y

config ZMK_RGB_UNDERGLOW_SPD_START
    default 3

config ZMK_RGB_UNDERGLOW_HUE_START
    default 0

config ZMK_RGB_UNDERGLOW_SAT_START
    default 100

config ZMK_RGB_UNDERGLOW_BRT_START
    default 50

config ZMK_RGB_UNDERGLOW_HUE_STEP
    default 10

config ZMK_RGB_UNDERGLOW_SAT_STEP
    default 10

config ZMK_RGB_UNDERGLOW_BRT_STEP
    default 10

config ZMK_RGB_UNDERGLOW_SPD_STEP
    default 1

config ZMK_RGB_UNDERGLOW_HUE_STEP_FAST
    default 30

config ZMK_RGB_UNDERGLOW_SAT_STEP_FAST
    default 30

config ZMK_RGB_UNDERGLOW_BRT_STEP_FAST
    default 30

config ZMK_RGB_UNDERGLOW_SPD_STEP_FAST
    default 3

config ZMK_RGB_UNDERGLOW_HUE_STEP_SLOW
    default 5

config ZMK_RGB_UNDERGLOW_SAT_STEP_SLOW
    default 5

config ZMK_RGB_UNDERGLOW_BRT_STEP_SLOW
    default 5

config ZMK_RGB_UNDERGLOW_SPD_STEP_SLOW
    default 1

config ZMK_RGB_UNDERGLOW_HUE_STEP_FASTEST
    default 60

config ZMK_RGB_UNDERGLOW_SAT_STEP_FASTEST
    default 60

config ZMK_RGB_UNDERGLOW_BRT_STEP_FASTEST
    default 60

config ZMK_RGB_UNDERGLOW_SPD_STEP_FASTEST
    default 5

config ZMK_RGB_UNDERGLOW_HUE_STEP_SLOWEST
    default 2

config ZMK_RGB_UNDERGLOW_SAT_STEP_SLOWEST
    default 2

config ZMK_RGB_UNDERGLOW_BRT_STEP_SLOWEST
    default 2

config ZMK_RGB_UNDERGLOW_SPD_STEP_SLOWEST
    default 1

endif # SHIELD_CORNE_CUSTOM_LEFT || SHIELD_CORNE_CUSTOM_RIGHT
```

## config/boards/shield/corne_custom/Kconfig.defconfig
```kconfig
if SHIELD_CORNE_CUSTOM

config ZMK_KEYBOARD_NAME
    default "Corne Custom"

config ZMK_SPLIT
    default y

config ZMK_SPLIT_ROLE_CENTRAL
    default y

config ZMK_USB
    default y

config ZMK_BLE
    default y

config ZMK_EXT_POWER
    default y

config ZMK_RGB_UNDERGLOW
    default y

config ZMK_RGB_UNDERGLOW_AUTO_OFF_IDLE
    default y

config ZMK_RGB_UNDERGLOW_AUTO_OFF_USB
    default y

config ZMK_RGB_UNDERGLOW_EFF_START
    default 2

config ZMK_RGB_UNDERGLOW_ON_START
    default y

config ZMK_RGB_UNDERGLOW_SPD_START
    default 3

config ZMK_RGB_UNDERGLOW_HUE_START
    default 0

config ZMK_RGB_UNDERGLOW_SAT_START
    default 100

config ZMK_RGB_UNDERGLOW_BRT_START
    default 50

endif # SHIELD_CORNE_CUSTOM
```

## config/boards/shield/corne_custom_left/Kconfig.defconfig
```kconfig
if SHIELD_CORNE_CUSTOM_LEFT

config ZMK_KEYBOARD_NAME
    default "Corne Custom Left"

config ZMK_SPLIT_ROLE_CENTRAL
    default y

endif # SHIELD_CORNE_CUSTOM_LEFT
```

## config/boards/shield/corne_custom_right/Kconfig.defconfig
```kconfig
if SHIELD_CORNE_CUSTOM_RIGHT

config ZMK_KEYBOARD_NAME
    default "Corne Custom Right"

endif # SHIELD_CORNE_CUSTOM_RIGHT
```

## config/boards/shield/corne_left/Kconfig.defconfig
```kconfig
if SHIELD_CORNE_LEFT

config ZMK_KEYBOARD_NAME
    default "Corne Left"

config ZMK_SPLIT_ROLE_CENTRAL
    default y

endif # SHIELD_CORNE_LEFT
```

## config/boards/shield/corne_right/Kconfig.defconfig
```kconfig
if SHIELD_CORNE_RIGHT

config ZMK_KEYBOARD_NAME
    default "Corne Right"

endif # SHIELD_CORNE_RIGHT
```

## config/boards/shield/corne_v4_left/Kconfig.defconfig
```kconfig
if SHIELD_CORNE_V4_LEFT

config ZMK_KEYBOARD_NAME
    default "Corne v4 Left"

config ZMK_SPLIT_ROLE_CENTRAL
    default y

endif # SHIELD_CORNE_V4_LEFT
```

## config/boards/shield/corne_v4_right/Kconfig.defconfig
```kconfig
if SHIELD_CORNE_V4_RIGHT

config ZMK_KEYBOARD_NAME
    default "Corne v4 Right"

endif # SHIELD_CORNE_V4_RIGHT
```

## config/boards/shield/corne_v4_right/Kconfig.shield
```kconfig
config SHIELD_CORNE_V4_RIGHT
    def_bool $(shields_list_contains,corne_v4_right)
```

## config/boards/shields/corne_left_custom/Kconfig.defconfig
```kconfig
if SHIELD_CORNE_LEFT_CUSTOM

config ZMK_KEYBOARD_NAME
    default "Corne Left Custom"

config ZMK_SPLIT_ROLE_CENTRAL
    default y

endif # SHIELD_CORNE_LEFT_CUSTOM
```

## shields/corne_left_custom/Kconfig.shield
```kconfig
config SHIELD_CORNE_LEFT_CUSTOM
    def_bool $(shields_list_contains,corne_left_custom)
```
