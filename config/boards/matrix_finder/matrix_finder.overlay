// config/boards/shields/matrix_finder/matrix_finder.overlay

#include <dt-bindings/zmk/matrix_transform.h>

/ {
    chosen {
        zmk,kscan = &kscan0;
    };

    kscan0: kscan {
        compatible = "zmk,kscan-gpio-matrix";
        label = "KSCAN";

        // Ваше первое предположение по строкам
        row-gpios
            = <&pro_micro 21 (GPIO_ACTIVE_HIGH)> // D0
            , <&pro_micro 20 (GPIO_ACTIVE_HIGH)> // D1
            , <&pro_micro 19 (GPIO_ACTIVE_HIGH)> // D2
            , <&pro_micro 18 (GPIO_ACTIVE_HIGH)> // D3
            ;

        // Ваше первое предположение по столбцам
        col-gpios
            = <&pro_micro 15 (GPIO_ACTIVE_HIGH)> // D4
            , <&pro_micro 16 (GPIO_ACTIVE_HIGH)> // D5
            , <&pro_micro 14 (GPIO_ACTIVE_HIGH)> // D6
            , <&pro_micro 10 (GPIO_ACTIVE_HIGH)> // D7
            , <&pro_micro 9 (GPIO_ACTIVE_HIGH)>  // D8
            ;
    };
};